// ============================================================
//  sleep - embedded white-noise player
//  ESP32-S3 + Adafruit VS1053 Codec/MicroSD breakout
// ============================================================

#include <Arduino.h>
#include <SPI.h>
#include <SD.h>
#include <WiFi.h>
#include <HTTPClient.h>
#include <Preferences.h>
#include <Update.h>
#include <Adafruit_VS1053.h>
#include "config.h"

// ── system sound headers (generated by tools/audio2header.py) ────
#include "sounds/Found_new_media.h"
#include "sounds/Found_Update.h"
#include "sounds/Hello_Sabine.h"
#include "sounds/New_media_downloaded.h"
#include "sounds/No_SD_card_found.h"
#include "sounds/Reboot.h"
#include "sounds/Update_installed.h"
#include "sounds/Update_downloaded.h"
#include "sounds/Boot.h"
#include "sounds/WARNING_no_audio_files_on_SD_card.h"

// ── globals ─────────────────────────────────────────────────
Adafruit_VS1053_FilePlayer player(
  PIN_VS_RESET, PIN_VS_CS, PIN_VS_DCS, PIN_VS_DREQ, PIN_SD_CS);

Preferences prefs;

// playback state
char trackPaths[MAX_TRACKS][64];
int  trackIndex     = 0;
int  trackCount     = 0;
bool isPlaying      = false;
uint8_t userVol     = VOL_DEFAULT;  // user-set volume (only changed by buttons/boot)

// fade state
enum FadeType { FADE_NONE, FADE_IN, FADE_OUT_STOP, FADE_OUT_SLEEP, FADE_OUT_XFADE };
struct {
  FadeType type          = FADE_NONE;
  unsigned long startMs  = 0;
  unsigned long durMs    = 0;
  uint8_t fromVol        = 0;
  uint8_t toVol          = 0;
  int     nextTrack      = -1;
} fade;

// timer state
enum TimerState { TIMER_OFF, TIMER_SELECTING, TIMER_RUNNING };
TimerState timerState       = TIMER_OFF;
int  timerPresetIdx         = 0;
unsigned long timerEndMs    = 0;
unsigned long timerSelectMs = 0;
bool timerFadeStarted       = false;

// volume LED display
unsigned long volDisplayUntil = 0;

// button debounce
unsigned long btnLastMs[BTN_COUNT] = {0};

// extra WiFi cred from SD card
char sdSsid[64] = {0};
char sdPass[64] = {0};
bool hasSdWifi  = false;

// ── forward declarations ────────────────────────────────────
void loadSdWifi();
void connectWiFi();
void checkOTA();
void downloadAudioFiles();
int  scanTracksOnSD();
void startTrack(int idx);
void stopPlayback();
void applyVolume(uint8_t v);
void beginFade(FadeType type, unsigned long durMs, int nextTrack = -1);
void handleFade();
void handleTimer();
void handleLEDs();
void handleButtons();
void playSystemSound(const uint8_t* data, size_t len);
void flashAllLEDs(int times, int onMs = 150, int offMs = 100);
void errorHalt();
void sineWaveLEDs(unsigned long durationMs = 0);

// usage: PLAY_SOUND(snd_example);
#define PLAY_SOUND(name) playSystemSound(name, name##_len)

// ============================================================
//  SETUP
// ============================================================
void setup() {
  Serial.begin(115200);
  delay(500);
  Serial.println("\n=== sleep - boot ===");

  // LED pins
  for (int i = 0; i < LED_COUNT; i++) {
    pinMode(LED_PINS[i], OUTPUT);
    digitalWrite(LED_PINS[i], LOW);
  }

  // boot animation
  sineWaveLEDs(1000);

  // button pins
  for (int i = 0; i < BTN_COUNT; i++) {
    pinMode(ALL_BTNS[i], INPUT_PULLUP);
  }

  // SPI bus on custom pins
  SPI.begin(PIN_SPI_SCK, PIN_SPI_MISO, PIN_SPI_MOSI);

  // ── VS1053 ───────────────────────────────────────────────
  if (!player.begin()) {
    Serial.println("ERROR: VS1053 not found");
    while (1) delay(1000);
  }
  Serial.println("VS1053 OK");

  // NOTE: useInterrupt(VS1053_FILEPLAYER_PIN_INT) is AVR-only and
  // crashes on ESP32-S3. We feed the buffer manually in loop().
  
  applyVolume(VOL_DEFAULT);

  // ── SD card ──────────────────────────────────────────────
  if (!SD.begin(PIN_SD_CS)) {
    Serial.println("ERROR: SD card init failed");
    PLAY_SOUND(No_SD_card_found);
    errorHalt();
  }
  Serial.println("SD OK");

  // PLAY_SOUND(Boot);

  // ── WiFi/OTA/download: only if PLAY button held at boot ───
  if (digitalRead(BTN_PLAY_STOP) == LOW) {
    Serial.println("PLAY held - entering update mode ...");
    // wait for button release
    while (digitalRead(BTN_PLAY_STOP) == LOW) delay(10);
    flashAllLEDs(1);

    loadSdWifi();
    connectWiFi();
    if (WiFi.status() == WL_CONNECTED) {
      Serial.println("WiFi connected: " + WiFi.localIP().toString());
      checkOTA();
      downloadAudioFiles();
      WiFi.disconnect(true);
      WiFi.mode(WIFI_OFF);
      Serial.println("WiFi off - running standalone");
    } else {
      Serial.println("No WiFi - update skipped");
    }
    flashAllLEDs(2);
  } else {
    Serial.println("Normal boot (hold PLAY for update mode)");
  }

  // ── scan tracks on SD ───────────────────────────────
  trackCount = scanTracksOnSD();
  Serial.printf("Tracks on SD: %d\n", trackCount);
  if (trackCount == 0) {
    Serial.println("WARNING: no audio files on SD card!");
    PLAY_SOUND(WARNING_no_audio_files_on_SD_card);
    errorHalt();
  }

  // ── NVS prefs ────────────────────────────────────────────
  prefs.begin("sleep", false);
#if ENABLE_VOL_BUTTONS
  userVol        = prefs.getUChar("volume", VOL_DEFAULT);
#else
  userVol        = VOL_MAX;  // no vol buttons -> max volume
#endif
  timerPresetIdx = prefs.getInt("timerIdx", 0);
  if (timerPresetIdx < 0 || timerPresetIdx >= TIMER_PRESET_COUNT) timerPresetIdx = 0;

  // restore last track by filename
  trackIndex = 0;
  String lastPath = prefs.getString("lastTrack", "");
  for (int i = 0; i < trackCount; i++) {
    if (lastPath == trackPaths[i]) { trackIndex = i; break; }
  }

  // ── start playing last track ─────────────────────────────
  if (trackCount > 0) {
    player.setVolume(VOL_MIN, VOL_MIN);  // start silent
    startTrack(trackIndex);
    beginFade(FADE_IN, FADE_MS);  // fade in slowly
    // auto-start timer if a preset was saved
    if (timerPresetIdx > 0) {
      int mins = TIMER_PRESETS[timerPresetIdx];
      timerEndMs = millis() + (unsigned long)mins * 60000UL;
      timerFadeStarted = false;
      timerState = TIMER_RUNNING;
      Serial.printf("Timer: auto-started %d min\n", mins);
    }
  }

  Serial.println("=== setup complete ===\n");
}

// ============================================================
//  LOOP
// ============================================================
void loop() {
  if (isPlaying && player.playingMusic) {
    player.feedBuffer();
  }

  // loop same track when it ends naturally (also during fade-out so audio stays audible)
  if (isPlaying && !player.playingMusic && fade.type != FADE_OUT_XFADE) {
    Serial.printf("-> loop %s\n", trackPaths[trackIndex]);
    startTrack(trackIndex);
  }

  handleFade();
  handleTimer();
  handleButtons();
  handleLEDs();
}

// ============================================================
//  Load WiFi credentials from /ssid.txt on SD
//  Format: ssid:password (single line)
// ============================================================
void loadSdWifi() {
  if (!SD.exists("/ssid.txt")) return;
  File f = SD.open("/ssid.txt");
  if (!f) return;
  String line = f.readStringUntil('\n');
  f.close();
  line.trim();
  int sep = line.indexOf(':');
  if (sep <= 0) {
    Serial.println("ssid.txt: bad format (expected ssid:password)");
    return;
  }
  line.substring(0, sep).toCharArray(sdSsid, sizeof(sdSsid));
  line.substring(sep + 1).toCharArray(sdPass, sizeof(sdPass));
  hasSdWifi = true;
  Serial.printf("ssid.txt: loaded \"%s\"\n", sdSsid);
}

// ============================================================
//  WiFi - scan first, then connect
// ============================================================
void connectWiFi() {
  WiFi.mode(WIFI_STA);

  Serial.print("WiFi: scanning ... ");
  int n = WiFi.scanNetworks();
  Serial.printf("%d found\n", n);

  auto tryConnect = [&](const char* ssid, const char* pass) -> bool {
    bool visible = false;
    for (int j = 0; j < n; j++) {
      if (WiFi.SSID(j) == ssid) { visible = true; break; }
    }
    if (!visible) {
      Serial.printf("  %s - not visible, skip\n", ssid);
      return false;
    }
    Serial.printf("  %s - connecting ... ", ssid);
    WiFi.begin(ssid, pass);
    unsigned long t0 = millis();
    while (WiFi.status() != WL_CONNECTED && millis() - t0 < WIFI_CONNECT_TIMEOUT_MS) {
      delay(250);
      Serial.print(".");
    }
    Serial.println();
    if (WiFi.status() == WL_CONNECTED) return true;
    WiFi.disconnect();
    return false;
  };

  if (hasSdWifi && tryConnect(sdSsid, sdPass)) {
    WiFi.scanDelete();
    return;
  }

  for (int i = 0; i < WIFI_CRED_COUNT; i++) {
    if (tryConnect(WIFI_CREDS[i].ssid, WIFI_CREDS[i].pass)) {
      WiFi.scanDelete();
      return;
    }
  }
  WiFi.scanDelete();
}

// ============================================================
//  OTA - check hash, flash firmware if newer
// ============================================================
void checkOTA() {
  Serial.println("OTA: checking hash ...");
  HTTPClient http;
  http.setFollowRedirects(HTTPC_STRICT_FOLLOW_REDIRECTS);
  http.begin(UPDATE_HASH_URL);
  int code = http.GET();
  if (code != 200) {
    Serial.printf("OTA: hash fetch failed at %s (%d)\n", UPDATE_HASH_URL, code);
    http.end();
    return;
  }

  String remoteHash = http.getString();
  http.end();
  remoteHash.trim();
  if (remoteHash.isEmpty()) {
    Serial.println("OTA: empty hash");
    return;
  }

  String localHash = prefs.getString("fwHash", "");
  Serial.printf("OTA: local=%s  remote=%s\n", localHash.c_str(), remoteHash.c_str());
  if (remoteHash == localHash) {
    Serial.println("OTA: up to date");
    return;
  }

  Serial.println("OTA: downloading firmware ...");
  PLAY_SOUND(Found_Update);
  HTTPClient http2;
  http2.setFollowRedirects(HTTPC_STRICT_FOLLOW_REDIRECTS);
  http2.begin(UPDATE_FW_URL);
  code = http2.GET();
  if (code != 200) {
    Serial.printf("OTA: firmware download failed (%d)\n", code);
    http2.end();
    return;
  }

  int contentLen = http2.getSize();
  if (contentLen <= 0) {
    Serial.println("OTA: unknown content length");
    http2.end();
    return;
  }

  if (!Update.begin(contentLen)) {
    Serial.println("OTA: not enough space");
    http2.end();
    return;
  }

  WiFiClient* stream = http2.getStreamPtr();
  size_t written = Update.writeStream(*stream);
  http2.end();

  if (written != (size_t)contentLen) {
    Serial.printf("OTA: wrote %u / %d\n", written, contentLen);
    Update.abort();
    return;
  }

  if (!Update.end(true)) {
    Serial.println("OTA: finalize failed");
    return;
  }

  prefs.putString("fwHash", remoteHash);
  PLAY_SOUND(Update_installed);
  Serial.println("OTA: success - rebooting ...");
  PLAY_SOUND(Reboot);
  delay(500);
  ESP.restart();
}

// ============================================================
//  Download audio files from server to SD
// ============================================================
void downloadAudioFiles() {
  Serial.println("Audio sync: find tracks online ...");
  char nameBuf[32];
  for (int i = 1; ; i++) {
    String url = String(AUDIO_BASE_URL) + String(i) + ".mp3";
    snprintf(nameBuf, sizeof(nameBuf), "/audio%d.mp3", i);

    HTTPClient http;
    http.setFollowRedirects(HTTPC_STRICT_FOLLOW_REDIRECTS);
    http.begin(url);
    int code = http.GET();
    if (code != 200) {
      Serial.printf("  audio%d.mp3 -> %d (stopping)\n", i, code);
      http.end();
      break;
    }

    int contentLen = http.getSize();

    // skip if file already exists with same size
    if (SD.exists(nameBuf)) {
      File existing = SD.open(nameBuf);
      if (existing && contentLen > 0 && existing.size() == (size_t)contentLen) {
        existing.close();
        http.end();
        Serial.printf("  audio%d.mp3 -> up to date\n", i);
        continue;
      }
      if (existing) existing.close();
      SD.remove(nameBuf);
    }

    WiFiClient* stream = http.getStreamPtr();
    File f = SD.open(nameBuf, FILE_WRITE);
    if (!f) {
      Serial.printf("  SD write error: %s\n", nameBuf);
      http.end();
      break;
    }

    uint8_t buf[512];
    int total = 0;
    while (http.connected() && (contentLen < 0 || total < contentLen)) {
      int avail = stream->available();
      if (avail <= 0) { continue; }
      int rd = stream->readBytes(buf, min((int)sizeof(buf), avail));
      if (rd <= 0) break;
      f.write(buf, rd);
      total += rd;
    }
    f.close();
    http.end();
    Serial.printf("  audio%d.mp3 -> %d bytes\n", i, total);
  }
}

// ============================================================
//  Track helpers
// ============================================================
bool isAudioFile(const char* name) {
  String lower = String(name);
  lower.toLowerCase();
  for (int i = 0; i < AUDIO_EXT_COUNT; i++) {
    if (lower.endsWith(AUDIO_EXTENSIONS[i])) return true;
  }
  return false;
}

int scanTracksOnSD() {
  File root = SD.open("/");
  if (!root) return 0;
  int count = 0;
  while (count < MAX_TRACKS) {
    File entry = root.openNextFile();
    if (!entry) break;
    if (entry.isDirectory()) { entry.close(); continue; }
    const char* name = entry.name();
    if (name[0] == '.') { entry.close(); continue; }  // skip hidden
    if (!isAudioFile(name)) { entry.close(); continue; }
    // store path (ESP32 SD returns name with leading /)
    if (name[0] == '/') {
      strncpy(trackPaths[count], name, 63);
    } else {
      snprintf(trackPaths[count], 64, "/%s", name);
    }
    trackPaths[count][63] = '\0';
    count++;
    entry.close();
  }
  root.close();

  // sort alphabetically for predictable order
  for (int i = 0; i < count - 1; i++) {
    for (int j = i + 1; j < count; j++) {
      if (strcasecmp(trackPaths[i], trackPaths[j]) > 0) {
        char tmp[64];
        memcpy(tmp, trackPaths[i], 64);
        memcpy(trackPaths[i], trackPaths[j], 64);
        memcpy(trackPaths[j], tmp, 64);
      }
    }
  }

  for (int i = 0; i < count; i++) {
    Serial.printf("  [%d] %s\n", i, trackPaths[i]);
  }
  return count;
}

void startTrack(int idx) {
  if (trackCount == 0) return;
  if (idx < 0 || idx >= trackCount) idx = 0;
  if (player.playingMusic) player.stopPlaying();

  Serial.printf(">  %s\n", trackPaths[idx]);

  if (!player.startPlayingFile(trackPaths[idx])) {
    Serial.printf("ERROR: could not play %s\n", trackPaths[idx]);
    isPlaying = false;
    return;
  }
  isPlaying  = true;
  trackIndex = idx;
  prefs.putString("lastTrack", trackPaths[idx]);
}

void stopPlayback() {
  if (player.playingMusic) player.stopPlaying();
  isPlaying = false;
  Serial.println("stopped");
}

// ============================================================
//  Flash all LEDs simultaneously
// ============================================================
void flashAllLEDs(int times, int onMs, int offMs) {
  for (int t = 0; t < times; t++) {
    for (int i = 0; i < LED_COUNT; i++) digitalWrite(LED_PINS[i], HIGH);
    delay(onMs);
    for (int i = 0; i < LED_COUNT; i++) digitalWrite(LED_PINS[i], LOW);
    if (t < times - 1) delay(offMs);
  }
}

// ============================================================
//  Sine-wave LED sweep. durationMs=0 means forever.
// ============================================================
void sineWaveLEDs(unsigned long durationMs) {
  unsigned long start = millis();
  while (durationMs == 0 || millis() - start < durationMs) {
    float t = (float)(millis() % 1000) / 1000.0f;
    float pos = (sinf(t * 2.0f * PI) + 1.0f) / 2.0f;
    int litIdx = (int)(pos * (LED_COUNT - 1) + 0.5f);
    for (int i = 0; i < LED_COUNT; i++) {
      digitalWrite(LED_PINS[i], i == litIdx ? HIGH : LOW);
    }
    delay(20);
  }
  for (int i = 0; i < LED_COUNT; i++) digitalWrite(LED_PINS[i], LOW);
}

void errorHalt() {
  sineWaveLEDs(0);  // forever
}

// ============================================================
//  System sounds (PROGMEM MP3 playback, blocking)
//  Include generated headers, then call: PLAY_SOUND(snd_name);
// ============================================================
void playSystemSound(const uint8_t* data, size_t len) {
  bool wasPlaying = isPlaying;
  if (player.playingMusic) player.stopPlaying();
  isPlaying = false;

  player.softReset();
  applyVolume(userVol);

  size_t offset = 0;
  while (offset < len) {
    size_t chunk = min((size_t)32, len - offset);
    uint8_t buf[32];
    memcpy_P(buf, data + offset, chunk);
    while (!player.readyForData()) { yield(); }
    player.playData(buf, chunk);
    offset += chunk;
  }

  // flush decoder with end-fill bytes
  uint8_t zeros[32] = {0};
  for (int i = 0; i < 64; i++) {
    while (!player.readyForData()) { yield(); }
    player.playData(zeros, sizeof(zeros));
  }

  player.softReset();
  applyVolume(userVol);
}

// ============================================================
//  Volume
// ============================================================
void applyVolume(uint8_t v) {
  v = constrain(v, VOL_MAX, VOL_MIN);
  player.setVolume(v, v);
}

// ============================================================
//  Fade engine
// ============================================================
void beginFade(FadeType type, unsigned long durMs, int nextTrack) {
  fade.type     = type;
  fade.startMs  = millis();
  fade.durMs    = durMs;
  fade.nextTrack = nextTrack;

  if (type == FADE_IN) {
    fade.fromVol = VOL_MIN;
    fade.toVol   = userVol;
    player.setVolume(VOL_MIN, VOL_MIN);
  } else {
    fade.fromVol = userVol;
    fade.toVol   = VOL_MIN;
  }
}

void handleFade() {
  if (fade.type == FADE_NONE) return;

  unsigned long elapsed = millis() - fade.startMs;
  if (elapsed >= fade.durMs) {
    player.setVolume(fade.toVol, fade.toVol);

    switch (fade.type) {
      case FADE_OUT_STOP:
      case FADE_OUT_SLEEP:
        stopPlayback();
        break;
      case FADE_OUT_XFADE: {
        player.setVolume(VOL_MIN, VOL_MIN);
        startTrack(fade.nextTrack);
        beginFade(FADE_IN, fade.durMs);  // fades from silence to userVol
        return;  // fade-in is now active
      }
      case FADE_IN:
        applyVolume(userVol);
        break;
      default: break;
    }
    fade.type = FADE_NONE;
    return;
  }

  float t = (float)elapsed / (float)fade.durMs;
  uint8_t vol = fade.fromVol + (int)((float)(fade.toVol - fade.fromVol) * t);
  player.setVolume(vol, vol);
}

// ============================================================
//  Timer
//  SELECTING: user is cycling presets; auto-starts after TIMER_CONFIRM_MS
//  RUNNING:   countdown active, triggers fade-out near end
// ============================================================
void handleTimer() {
  unsigned long now = millis();

  // auto-start after confirmation delay
  if (timerState == TIMER_SELECTING && (now - timerSelectMs) >= TIMER_CONFIRM_MS) {
    if (timerPresetIdx == 0) {
      timerState = TIMER_OFF;
      Serial.println("Timer: off");
    } else if (isPlaying) {
      int mins = TIMER_PRESETS[timerPresetIdx];
      timerEndMs = now + (unsigned long)mins * 60000UL;
      timerFadeStarted = false;
      timerState = TIMER_RUNNING;
      Serial.printf("Timer: started %d min\n", mins);
    } else {
      // not playing - just dismiss LED display; timer starts with next play
      timerState = TIMER_OFF;
    }
  }

  if (timerState != TIMER_RUNNING || !isPlaying) return;

  unsigned long fadeStartAt = timerEndMs - FADE_SLEEP_MS;
  if (!timerFadeStarted && now >= fadeStartAt) {
    Serial.println("Timer: starting 60s fade-out");
    beginFade(FADE_OUT_SLEEP, FADE_SLEEP_MS);
    timerFadeStarted = true;
  }

  if (now >= timerEndMs) {
    timerEndMs = 0;
    timerFadeStarted = false;
    timerPresetIdx = 0;
    timerState = TIMER_OFF;
    Serial.println("Timer: expired");
  }
}

// ============================================================
//  LED bar
//  SELECTING: fill L->R proportional to preset index
//  RUNNING:   single LED sweeps R->L as time elapses
//  OFF:       all dark
// ============================================================
void handleLEDs() {
  // volume display takes priority (temporary, after vol button press)
  if (millis() < volDisplayUntil) {
    float pct = (float)(VOL_MIN - userVol) / (float)(VOL_MIN - VOL_MAX);
    int litIdx = (int)(pct * (LED_COUNT - 1) + 0.5f);
    litIdx = constrain(litIdx, 0, LED_COUNT - 1);
    for (int i = 0; i < LED_COUNT; i++) {
      digitalWrite(LED_PINS[i], i == litIdx ? HIGH : LOW);
    }
    return;
  }

  if (timerState == TIMER_OFF) {
    for (int i = 0; i < LED_COUNT; i++) digitalWrite(LED_PINS[i], LOW);
    return;
  }

  if (timerState == TIMER_SELECTING) {
    int lit = 0;
    if (timerPresetIdx > 0) {
      lit = (int)((float)timerPresetIdx / (float)(TIMER_PRESET_COUNT - 1) * LED_COUNT + 0.5f);
      lit = constrain(lit, 1, LED_COUNT);
    }
    for (int i = 0; i < LED_COUNT; i++) {
      digitalWrite(LED_PINS[i], i < lit ? HIGH : LOW);
    }
    return;
  }

  // TIMER_RUNNING: single LED indicates remaining fraction
  if (timerEndMs == 0 || millis() >= timerEndMs) {
    for (int i = 0; i < LED_COUNT; i++) digitalWrite(LED_PINS[i], LOW);
    return;
  }

  // max LED = same as the last lit LED during selection
  int maxLit = (int)((float)timerPresetIdx / (float)(TIMER_PRESET_COUNT - 1) * LED_COUNT + 0.5f);
  maxLit = constrain(maxLit, 1, LED_COUNT);
  int maxIdx = maxLit - 1;

  unsigned long totalMs  = (unsigned long)TIMER_PRESETS[timerPresetIdx] * 60000UL;
  unsigned long remainMs = timerEndMs - millis();
  int litIdx = (int)((float)remainMs / (float)totalMs * maxIdx + 0.5f);
  litIdx = constrain(litIdx, 0, maxIdx);

  // blink the timer LED during any fade-out
  bool fading = (fade.type == FADE_OUT_STOP || fade.type == FADE_OUT_SLEEP || fade.type == FADE_OUT_XFADE);
  bool blinkOn = (millis() / 250) % 2 == 0;

  for (int i = 0; i < LED_COUNT; i++) {
    if (i == litIdx) {
      digitalWrite(LED_PINS[i], (fading ? blinkOn : HIGH));
    } else {
      digitalWrite(LED_PINS[i], LOW);
    }
  }
}

// ============================================================
//  Buttons (active-LOW, debounced)
// ============================================================
bool btnPressed(uint8_t pin, int idx) {
  if (digitalRead(pin) == LOW) {
    unsigned long now = millis();
    if (now - btnLastMs[idx] > DEBOUNCE_MS) {
      btnLastMs[idx] = now;
      return true;
    }
  }
  return false;
}

void handleButtons() {
  // PLAY / STOP toggle
  if (btnPressed(BTN_PLAY_STOP, 0)) {
    if (isPlaying) {
      // fade-stop
      beginFade(FADE_OUT_STOP, FADE_STOP_MS);
    } else if (trackCount > 0) {
      // play last track
      fade.type = FADE_NONE;
      applyVolume(userVol);
      startTrack(trackIndex);
      // auto-start timer if a preset is selected
      if (timerPresetIdx > 0) {
        int mins = TIMER_PRESETS[timerPresetIdx];
        timerEndMs = millis() + (unsigned long)mins * 60000UL;
        timerFadeStarted = false;
        timerState = TIMER_RUNNING;
        Serial.printf("Timer: auto-started %d min\n", mins);
      }
    }
  }

  // TRACK - cycle to next (crossfade if playing)
  if (btnPressed(BTN_TRACK, 1)) {
    if (trackCount == 0) return;
    int next = trackIndex + 1;
    if (next >= trackCount) next = 0;
    if (isPlaying) {
      beginFade(FADE_OUT_XFADE, FADE_MS, next);
    } else {
      trackIndex = next;
      prefs.putString("lastTrack", trackPaths[trackIndex]);
      Serial.printf("Track: %s (%d/%d)\n", trackPaths[trackIndex], trackIndex + 1, trackCount);
    }
  }

  // TIMER - cycle presets, save to NVS, show on LED bar
  if (btnPressed(BTN_TIMER, 2)) {
    timerPresetIdx++;
    if (timerPresetIdx >= TIMER_PRESET_COUNT) timerPresetIdx = 0;
    prefs.putInt("timerIdx", timerPresetIdx);
    Serial.printf("Timer preset: %d min\n", TIMER_PRESETS[timerPresetIdx]);

    // cancel any running timer/fade
    if (timerState == TIMER_RUNNING) {
      timerEndMs = 0;
      timerFadeStarted = false;
      if (fade.type == FADE_OUT_SLEEP) {
        fade.type = FADE_NONE;
        applyVolume(userVol);
      }
    }

    timerState = (timerPresetIdx == 0) ? TIMER_OFF : TIMER_SELECTING;
    timerSelectMs = millis();
  }

#if ENABLE_VOL_BUTTONS
  // VOLUME UP
  if (btnPressed(BTN_VOL_UP, 3)) {
    int v = (int)userVol - VOL_STEP;
    if (v < VOL_MAX) v = VOL_MAX;
    userVol = (uint8_t)v;
    applyVolume(userVol);
    prefs.putUChar("volume", userVol);
    volDisplayUntil = millis() + TIMER_CONFIRM_MS;
    Serial.printf("Vol: %d\n", userVol);
  }

  // VOLUME DOWN
  if (btnPressed(BTN_VOL_DOWN, 4)) {
    int v = (int)userVol + VOL_STEP;
    if (v > VOL_MIN) v = VOL_MIN;
    userVol = (uint8_t)v;
    applyVolume(userVol);
    prefs.putUChar("volume", userVol);
    volDisplayUntil = millis() + TIMER_CONFIRM_MS;
    Serial.printf("Vol: %d\n", userVol);
  }
#endif
}
